## drivers/blt/Kconfig
```kconfig
# drivers/blt/Kconfig

if ARCH_MXC

menu "SBC-i.MX51 support drivers"
source "drivers/blt/gps/Kconfig"
source "drivers/blt/gsm/Kconfig"
source "drivers/blt/io/Kconfig"
endmenu

endif
```

## drivers/blt/gps/Kconfig
```kconfig
#
# GPS
#

menu "GPS support"

config BLT_SBC_GPS
	tristate "SBC-i.MX51 GPS support"
	depends on MACH_MX51_3DS
	---help---
         Say Y to support GPS module on ADP-SBC-i.MX51-COMM extension board.

endmenu
```

## drivers/blt/gsm/Kconfig
```kconfig
#
# GSM/GPRS
#

menu "GSM/GPRS support"

config BLT_SBC_GSM
	tristate "SBC-i.MX51 GSM/GPRS support"
	depends on MACH_MX51_3DS
	---help---
         Say Y to support GSM/GPRS module on ADP-SBC-i.MX51-COMM extension
	 board.

endmenu
```

## drivers/blt/io/Kconfig
```kconfig
#
# GSM/GPRS
#

menu "IO Port support"

config BLT_SBC_IO
	tristate "SBC-i.MX51 IO Card support"
	depends on MACH_MX51_3DS
	---help---
         Say Y to support IO ports on IO extension.

endmenu
```
